## config/west.yml
```yaml
manifest:
  remotes:
    - name: zmkfirmware
      url-base: https://github.com/zmkfirmware
    - name: caksoylar
      url-base: https://github.com/caksoylar
    - name: badjeff
      url-base: https://github.com/badjeff
    - name: ssbb
      url-base: https://github.com/ssbb
    - name: te9no
      url-base: https://github.com/te9no
    - name: kot149
      url-base: https://github.com/kot149
    - name: mctechnology17
      url-base: https://github.com/mctechnology17
    - name: petejohanson
      url-base: https://github.com/petejohanson
  projects:
    - name: zmk
      remote: zmkfirmware
      revision: abb64ba
      import: app/west.yml

    # https://github.com/caksoylar/zmk-rgbled-widget
    - name: zmk-rgbled-widget
      remote: caksoylar
      revision: main
      path: modules/zmk-rgbled-widget

    # https://github.com/badjeff/zmk-pmw3610-driver
    - name: zmk-pmw3610-driver
      remote: badjeff
      revision: zmk-0.4
      path: modules/zmk-pmw3610-driver-badjeff

    # https://github.com/badjeff/zmk-analog-input-driver
    - name: zmk-analog-input-driver
      remote: badjeff
      revision: main
      path: modules/zmk-analog-input-driver

    # https://github.com/te9no/zmk-dongle-display
    # - name: zmk-dongle-display
    #   remote: te9no
    #   revision: main
    #   path: modules/zmk-dongle-display-te9no

    # https://github.com/mctechnology17/zmk-nice-oled
    - name: zmk-nice-oled
      remote: mctechnology17
      revision: main
      path: modules/zmk-nice-oled

    # https://github.com/te9no/zmk-driver-tlx493d-2
    # - name: zmk-driver-tlx493d-2
    #   remote: te9no
    #   revision: main
    #   path: modules/zmk-driver-tlx493d-2-te9no

    # - name: zmk-driver-LIS3MDLTR
    #   remote: te9no
    #   revision: main

    # https://github.com/badjeff/zmk-input-processor-report-rate-limit
    - name: zmk-input-processor-report-rate-limit
      remote: badjeff
      revision: main
      path: modules/zmk-input-processor-report-rate-limit

    # https://github.com/ssbb/zmk-listeners
    - name: zmk-listeners
      remote: ssbb
      revision: v1
      path: modules/zmk-listeners

    # https://github.com/kot149/zmk-mouse-gesture
    - name: zmk-mouse-gesture
      remote: kot149
      revision: v1
      path: modules/zmk-mouse-gesture

    # https://github.com/kot149/zmk-layout-shift
    - name: zmk-layout-shift
      remote: kot149
      revision: v1
      path: modules/zmk-layout-shift

    # https://github.com/kot149/zmk-scroll-snap
    - name: zmk-scroll-snap
      remote: kot149
      revision: v1
      path: modules/zmk-scroll-snap

    - name: zmk-input-processor-keybind
      remote: te9no
      revision: main
      path: modules/zmk-input-processor-keybind-te9no
    - name: cirque-input-module
      remote: petejohanson
      revision: main
      path: modules/cirque-input-module
    - name: zmk-driver-MLX90393
      remote: te9no
      revision: main
      path: modules/zmk-driver-MLX90393

  self:
    path: config
```
